## main/Kconfig.projbuild
```kconfig
menu "Printer Monitor Configuration"

    config DISPLAY_BRIGHTNESS
        int "Display Brightness (0-100)"
        default 80
        help
            Default display brightness percentage

endmenu
```

## sdkconfig.defaults
```kconfig
CONFIG_ESPTOOLPY_FLASHSIZE_4MB=y
CONFIG_ESPTOOLPY_FLASHSIZE="4MB"
CONFIG_PARTITION_TABLE_SINGLE_APP=y
CONFIG_FREERTOS_HZ=1000
CONFIG_LV_USE_MEM_MONITOR=y
CONFIG_LV_USE_PERF_MONITOR=y
CONFIG_LV_FONT_MONTSERRAT_12=1
CONFIG_LV_FONT_MONTSERRAT_24=1
CONFIG_LV_FONT_MONTSERRAT_10=1
CONFIG_LV_FONT_MONTSERRAT_14=1
CONFIG_WIFI_CONN_MAX_RETRY=10
CONFIG_ESP_HTTP_CLIENT_ENABLE_HTTPS=n
CONFIG_ESP_HTTP_CLIENT_ENABLE_BASIC_AUTH=n
CONFIG_CJSON_ENABLED=y
```
